## designtree/dts/bindings/Broadcom_Broadcom_DFN-6_2x2mm_P0.65mm.yaml
```yaml
compatible: custom,Broadcom:Broadcom_DFN-6_2x2mm_P0.65mm
description: Binding for Broadcom:Broadcom_DFN-6_2x2mm_P0.65mm
properties:
  label:
    description: Human-readable label
    type: string
```

## designtree/dts/bindings/CUI Devices_CMT-322-65-SMT-TR.yaml
```yaml
compatible: custom,CUI Devices:CMT-322-65-SMT-TR
description: Binding for CUI Devices:CMT-322-65-SMT-TR
properties:
  label:
    description: Human-readable label
    type: string
```

## designtree/dts/bindings/Capacitor_SMD_C_0402_1005Metric.yaml
```yaml
compatible: custom,Capacitor_SMD:C_0402_1005Metric
description: Binding for Capacitor_SMD:C_0402_1005Metric
properties:
  label:
    description: Human-readable label
    type: string
```

## designtree/dts/bindings/Capacitor_SMD_C_0603_1608Metric.yaml
```yaml
compatible: custom,Capacitor_SMD:C_0603_1608Metric
description: Binding for Capacitor_SMD:C_0603_1608Metric
properties:
  label:
    description: Human-readable label
    type: string
```

## designtree/dts/bindings/Diode_SMD_D_SOD-323.yaml
```yaml
compatible: custom,Diode_SMD:D_SOD-323
description: Binding for Diode_SMD:D_SOD-323
properties:
  label:
    description: Human-readable label
    type: string
```

## designtree/dts/bindings/E-Switch_TL6340AF160Q_Modified.yaml
```yaml
compatible: custom,E-Switch:TL6340AF160Q_Modified
description: Binding for E-Switch:TL6340AF160Q_Modified
properties:
  label:
    description: Human-readable label
    type: string
```

## designtree/dts/bindings/Inductor_SMD_Kampi_L_0806_2016.yaml
```yaml
compatible: custom,Inductor_SMD_Kampi:L_0806_2016
description: Binding for Inductor_SMD_Kampi:L_0806_2016
properties:
  label:
    description: Human-readable label
    type: string
```

## designtree/dts/bindings/Jumper_SolderJumper-2_P1.3mm_Open_RoundedPad1.0x1.5mm.yaml
```yaml
compatible: custom,Jumper:SolderJumper-2_P1.3mm_Open_RoundedPad1.0x1.5mm
description: Binding for Jumper:SolderJumper-2_P1.3mm_Open_RoundedPad1.0x1.5mm
properties:
  label:
    description: Human-readable label
    type: string
```

## designtree/dts/bindings/Knowles_SPK0641HT4H-1.yaml
```yaml
compatible: custom,Knowles:SPK0641HT4H-1
description: Binding for Knowles:SPK0641HT4H-1
properties:
  label:
    description: Human-readable label
    type: string
```

## designtree/dts/bindings/Micro Crystal_RV-8263-C8.yaml
```yaml
compatible: custom,Micro Crystal:RV-8263-C8
description: Binding for Micro Crystal:RV-8263-C8
properties:
  label:
    description: Human-readable label
    type: string
```

## designtree/dts/bindings/Molex_78171-0002.yaml
```yaml
compatible: custom,Molex:78171-0002
description: Binding for Molex:78171-0002
properties:
  label:
    description: Human-readable label
    type: string
```

## designtree/dts/bindings/Package_DFN_QFN_QFN-32-1EP_5x5mm_P0.5mm_EP3.6x3.6mm_ThermalVias.yaml
```yaml
compatible: custom,Package_DFN_QFN:QFN-32-1EP_5x5mm_P0.5mm_EP3.6x3.6mm_ThermalVias
description: Binding for Package_DFN_QFN:QFN-32-1EP_5x5mm_P0.5mm_EP3.6x3.6mm_ThermalVias
properties:
  label:
    description: Human-readable label
    type: string
```

## designtree/dts/bindings/Package_LGA_Kampi_Bosch_LGA-10_2x2mm_P0.5mm_ClockwisePinNumbering.yaml
```yaml
compatible: custom,Package_LGA_Kampi:Bosch_LGA-10_2x2mm_P0.5mm_ClockwisePinNumbering
description: Binding for Package_LGA_Kampi:Bosch_LGA-10_2x2mm_P0.5mm_ClockwisePinNumbering
properties:
  label:
    description: Human-readable label
    type: string
```

## designtree/dts/bindings/Package_LGA_Kampi_Bosch_LGA-14_3x2.5mm_P0.5mm_LayoutBorder3x4y.yaml
```yaml
compatible: custom,Package_LGA_Kampi:Bosch_LGA-14_3x2.5mm_P0.5mm_LayoutBorder3x4y
description: Binding for Package_LGA_Kampi:Bosch_LGA-14_3x2.5mm_P0.5mm_LayoutBorder3x4y
properties:
  label:
    description: Human-readable label
    type: string
```

## designtree/dts/bindings/Package_LGA_Kampi_Bosch_LGA-8_3x3mm_P0.8mm_ClockwisePinNumbering.yaml
```yaml
compatible: custom,Package_LGA_Kampi:Bosch_LGA-8_3x3mm_P0.8mm_ClockwisePinNumbering
description: Binding for Package_LGA_Kampi:Bosch_LGA-8_3x3mm_P0.8mm_ClockwisePinNumbering
properties:
  label:
    description: Human-readable label
    type: string
```

## designtree/dts/bindings/Package_LGA_Kampi_LGA-12_2x2mm_P0.5mm.yaml
```yaml
compatible: custom,Package_LGA_Kampi:LGA-12_2x2mm_P0.5mm
description: Binding for Package_LGA_Kampi:LGA-12_2x2mm_P0.5mm
properties:
  label:
    description: Human-readable label
    type: string
```

## designtree/dts/bindings/Package_QFN_UQFN-10_1.55x2.05mm_P0.5mm.yaml
```yaml
compatible: custom,Package_QFN:UQFN-10_1.55x2.05mm_P0.5mm
description: Binding for Package_QFN:UQFN-10_1.55x2.05mm_P0.5mm
properties:
  label:
    description: Human-readable label
    type: string
```

## designtree/dts/bindings/Package_QFN_WQFN-10_2x2mm_P0.5mm.yaml
```yaml
compatible: custom,Package_QFN:WQFN-10_2x2mm_P0.5mm
description: Binding for Package_QFN:WQFN-10_2x2mm_P0.5mm
properties:
  label:
    description: Human-readable label
    type: string
```

## designtree/dts/bindings/Package_QFN_XQFN-12-1.7x2mm_P0.4mm.yaml
```yaml
compatible: custom,Package_QFN:XQFN-12-1.7x2mm_P0.4mm
description: Binding for Package_QFN:XQFN-12-1.7x2mm_P0.4mm
properties:
  label:
    description: Human-readable label
    type: string
```

## designtree/dts/bindings/Package_SON_WSON-8-1EP_8x6mm_P1.27mm_EP3.4x4.3mm.yaml
```yaml
compatible: custom,Package_SON:WSON-8-1EP_8x6mm_P1.27mm_EP3.4x4.3mm
description: Binding for Package_SON:WSON-8-1EP_8x6mm_P1.27mm_EP3.4x4.3mm
properties:
  label:
    description: Human-readable label
    type: string
```

## designtree/dts/bindings/Package_SOT_SMD_SOT-883.yaml
```yaml
compatible: custom,Package_SOT_SMD:SOT-883
description: Binding for Package_SOT_SMD:SOT-883
properties:
  label:
    description: Human-readable label
    type: string
```

## designtree/dts/bindings/Package_TO_SOT_SMD_SOT-323_SC-70.yaml
```yaml
compatible: custom,Package_TO_SOT_SMD:SOT-323_SC-70
description: Binding for Package_TO_SOT_SMD:SOT-323_SC-70
properties:
  label:
    description: Human-readable label
    type: string
```

## designtree/dts/bindings/Package_TO_SOT_SMD_SOT-665.yaml
```yaml
compatible: custom,Package_TO_SOT_SMD:SOT-665
description: Binding for Package_TO_SOT_SMD:SOT-665
properties:
  label:
    description: Human-readable label
    type: string
```

## designtree/dts/bindings/Package_TO_SOT_SMD_TSOT-23-6.yaml
```yaml
compatible: custom,Package_TO_SOT_SMD:TSOT-23-6
description: Binding for Package_TO_SOT_SMD:TSOT-23-6
properties:
  label:
    description: Human-readable label
    type: string
```

## designtree/dts/bindings/Pomagtor_RD90_LZH0230529-004_DJ-5PIN_PH2_54.yaml
```yaml
compatible: custom,Pomagtor:RD90_LZH0230529-004_DJ-5PIN_PH2_54
description: Binding for Pomagtor:RD90_LZH0230529-004_DJ-5PIN_PH2_54
properties:
  label:
    description: Human-readable label
    type: string
```

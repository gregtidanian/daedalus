## designtree/dts/bindings/Resistor_SMD_R_0402_1005Metric.yaml
```yaml
compatible: custom,Resistor_SMD:R_0402_1005Metric
description: Binding for Resistor_SMD:R_0402_1005Metric
properties:
  label:
    description: Human-readable label
    type: string
```

## designtree/dts/bindings/Resistor_SMD_R_0603_1608Metric.yaml
```yaml
compatible: custom,Resistor_SMD:R_0603_1608Metric
description: Binding for Resistor_SMD:R_0603_1608Metric
properties:
  label:
    description: Human-readable label
    type: string
```

## designtree/dts/bindings/TestPoint_TestPoint_Pad_1.0x1.0mm.yaml
```yaml
compatible: custom,TestPoint:TestPoint_Pad_1.0x1.0mm
description: Binding for TestPoint:TestPoint_Pad_1.0x1.0mm
properties:
  label:
    description: Human-readable label
    type: string
```

## designtree/dts/bindings/TestPoint_TestPoint_Pad_D1.0mm.yaml
```yaml
compatible: custom,TestPoint:TestPoint_Pad_D1.0mm
description: Binding for TestPoint:TestPoint_Pad_D1.0mm
properties:
  label:
    description: Human-readable label
    type: string
```

## designtree/dts/bindings/uBlox_NORA-B106.yaml
```yaml
compatible: custom,uBlox:NORA-B106
description: Binding for uBlox:NORA-B106
properties:
  label:
    description: Human-readable label
    type: string
```

## designtree/dts/bindings/unknown.yaml
```yaml
compatible: custom,unknown
description: Binding for unknown
properties:
  label:
    description: Human-readable label
    type: string
```
